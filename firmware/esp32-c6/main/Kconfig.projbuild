## firmware/esp32-c6/main/Kconfig.projbuild
```kconfig
menu "Alerts device"

config ALERTS_WIFI_SSID
	string "Wi-Fi SSID"
	default "YOUR_SSID"

config ALERTS_WIFI_PASSWORD
	string "Wi-Fi password"
	default "YOUR_PASSWORD"

config ALERTS_API_BASE_URL
	string "API base URL, https, no trailing slash"
	default "https://example.invalid"

config ALERTS_DEVICE_API_TOKEN
	string "DEVICE_API_TOKEN, same value as the Worker secret"
	default "replace-me"

config ALERTS_POLL_INTERVAL_S
	int "Schedule poll interval in seconds"
	default 300
	range 30 3600

config ALERTS_HEAP_FLOOR_KB
	int "Serial recipe fails if free heap is below this after first poll, in KB"
	default 40
	range 40 256

endmenu
```

## firmware/esp32-c6/sdkconfig.defaults
```kconfig
CONFIG_IDF_TARGET="esp32c6"
CONFIG_ESP_MAIN_TASK_STACK_SIZE=16384
CONFIG_ESPTOOLPY_FLASHSIZE_8MB=y
CONFIG_PARTITION_TABLE_CUSTOM=y
CONFIG_PARTITION_TABLE_CUSTOM_FILENAME="partitions.csv"
CONFIG_MBEDTLS_CERTIFICATE_BUNDLE=y
CONFIG_ESP_HTTP_CLIENT_ENABLE_HTTPS=y
CONFIG_ESP_TLS_USING_MBEDTLS=y
CONFIG_ALERTS_WIFI_SSID="YOUR_SSID"
CONFIG_ALERTS_WIFI_PASSWORD="YOUR_PASSWORD"
CONFIG_ALERTS_API_BASE_URL="https://example.invalid"
CONFIG_ALERTS_DEVICE_API_TOKEN="replace-me"
CONFIG_ALERTS_POLL_INTERVAL_S=300
CONFIG_ALERTS_HEAP_FLOOR_KB=40
CONFIG_ALERTS_LVGL_DRAW_LINES=20
CONFIG_LV_FONT_MONTSERRAT_20=y
CONFIG_LV_FONT_MONTSERRAT_28=y
```
